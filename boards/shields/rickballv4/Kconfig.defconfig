## boards/shields/rickballv4/Kconfig.defconfig
```kconfig
if SHIELD_rickballv4_RIGHT

config ZMK_KEYBOARD_NAME
    default "rickballv4"

config ZMK_SPLIT_ROLE_CENTRAL
    default y

endif # SHIELD_rickballv4_RIGHT

if SHIELD_rickballv4_LEFT || SHIELD_rickballv4_RIGHT

config ZMK_SPLIT
    default y

endif # SHIELD_rickballv4_LEFT || SHIELD_rickballv4_RIGHT
```

## boards/shields/rickballv4/Kconfig.shield
```kconfig
config SHIELD_rickballv4_LEFT
    def_bool $(shields_list_contains,rickballv4_left)

config SHIELD_rickballv4_RIGHT
    def_bool $(shields_list_contains,rickballv4_right)
```

## boards/shields/rickballv6/Kconfig.defconfig
```kconfig
if SHIELD_rickballv6_RIGHT

config ZMK_KEYBOARD_NAME
    default "rickballv6"

config ZMK_SPLIT_ROLE_CENTRAL
    default y

endif # SHIELD_rickballv6_RIGHT

if SHIELD_rickballv6_LEFT || SHIELD_rickballv6_RIGHT

config ZMK_SPLIT
    default y

endif # SHIELD_rickballv6_LEFT || SHIELD_rickballv6_RIGHT
```

## boards/shields/rickballv6/Kconfig.shield
```kconfig
config SHIELD_rickballv6_LEFT
    def_bool $(shields_list_contains,rickballv6_left)

config SHIELD_rickballv6_RIGHT
    def_bool $(shields_list_contains,rickballv6_right)
```

## boards/shields/rickballv7/Kconfig.defconfig
```kconfig
if SHIELD_rickballv7_RIGHT

config ZMK_KEYBOARD_NAME
    default "rickballv7"

config ZMK_SPLIT_ROLE_CENTRAL
    default y

endif # SHIELD_rickballv7_RIGHT

if SHIELD_rickballv7_LEFT || SHIELD_rickballv7_RIGHT

config ZMK_SPLIT
    default y

endif # SHIELD_rickballv7_LEFT || SHIELD_rickballv7_RIGHT
```

## boards/shields/rickballv7/Kconfig.shield
```kconfig
config SHIELD_rickballv7_LEFT
    def_bool $(shields_list_contains,rickballv7_left)

config SHIELD_rickballv7_RIGHT
    def_bool $(shields_list_contains,rickballv7_right)
```
