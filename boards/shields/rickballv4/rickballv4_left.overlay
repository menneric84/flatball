#include "rickballv4.dtsi"

/ {
    bootloader_key: bootloader_key {
        compatible = "zmk,boot-magic-key";
        key-position = <0>;
        jump-to-bootloader;
    };
};

&left_encoder {
    status = "okay";
};
