#include "rickballv6.dtsi"

/ {
    bootloader_key: bootloader_key {
        compatible = "zmk,boot-magic-key";
        key-position = <43>;
        jump-to-bootloader;
    };
};

&default_transform {
    col-offset = <7>;
};
